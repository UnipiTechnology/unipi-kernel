// SPDX-License-Identifier: (GPL-2.0+ OR MIT)
/*
 * Copyright 2023 Unipi Technology
 * Copyright 2020 Faster CZ
 * Copyright 2019 NXP
 */

/dts-v1/;

#include <dt-bindings/usb/pd.h>
#include "unipi-zulu.dtsi"

/ {
	model = "Unipi Zulu (i.MX8MM)";
};
